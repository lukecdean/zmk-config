        copy_all: copy_all {
            label = "copy_all";
            compatible = "zmk,behavior-macro";
            #binding-cells = <0>;
            wait-ms = <3>;
            bindings
                = <&macro_press &kp LCTRL>
                , <&macro_tap &kp A>
                , <&macro_tap &kp C>
                , <&macro_release &kp LCTRL>
                , <&macro_tap &kp RIGHT>
                ;
        };
